## drivers/input/touchscreen/ft8719_spi_c3j/Kconfig
```kconfig
#
# Focaltech Touchscreen driver configuration
#

config TOUCHSCREEN_FTS_C3J
	bool "Focaltech Touchscreen"
	depends on SPI
	default n
	help
		Say Y here if you have Focaltech touch panel.
		If unsure, say N.
```
