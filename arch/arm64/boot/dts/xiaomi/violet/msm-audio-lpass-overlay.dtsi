/* SPDX-License-Identifier: GPL-2.0 */

&dai_mi2s0 {
	qcom,msm-mi2s-rx-lines = <1>;
	qcom,msm-mi2s-tx-lines = <2>;
};

&dai_mi2s1 {
	qcom,msm-mi2s-tx-lines = <2>;
};

&dai_mi2s2 {
	qcom,msm-mi2s-rx-lines = <1>;
	qcom,msm-mi2s-tx-lines = <2>;	
};
