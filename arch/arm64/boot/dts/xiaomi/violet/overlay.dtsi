/* SPDX-License-Identifier: GPL-2.0 */

#include "sm6150-overlay.dtsi"
#include "sm6150-sde-display-overlay.dtsi"
#include "sm6150-idp-overlay.dtsi"
#include "sm6150-audio-overlay.dtsi"
#include "sm6150-camera-overlay.dtsi"
#include "sm6150-camera-sensor-idp-overlay.dtsi"
#include "sm6150-regulator-overlay.dtsi"
#include "sm6150-pinctrl-overlay.dtsi"
#include "msm-audio-lpass-overlay.dtsi"
#include "pm6150-overlay.dtsi"
#include "pm6150l-overlay.dtsi"
