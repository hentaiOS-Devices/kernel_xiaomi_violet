/* Copyright (c) 2020, The Linux Foundation. All rights reserved.
 *
 * This program is free software; you can redistribute it and/or modify
 * it under the terms of the GNU General Public License version 2 and
 * only version 2 as published by the Free Software Foundation.
 *
 * This program is distributed in the hope that it will be useful,
 * but WITHOUT ANY WARRANTY; without even the implied warranty of
 * MERCHANTABILITY or FITNESS FOR A PARTICULAR PURPOSE.  See the
 * GNU General Public License for more details.
 */

&usb0 {
	google,switch-vbus = <500>;
	dwc3@a600000 {
		usb-phy = <&qusb_phy0>, <&usb_nop_phy>;
		maximum-speed = "high-speed";
	};
};

&usb_qmp_phy {
	status = "disabled";
};

&qusb_phy0 {
	qcom,qusb-phy-init-seq = 
			<0xc8 0x80
			0x73 0x84
			0x83 0x88
			0xc7 0x8c
			0x30 0x08
			0x79 0x0c
			0x21 0x10
			0x14 0x9c
			0x9f 0x1c
			0x00 0x18>;
	reg = <0x88e2000 0x180>,
		<0x01fcb250 0x4>;
	reg-names = "qusb_phy_base",
		"tcsr_clamp_dig_n_1p8";
};
