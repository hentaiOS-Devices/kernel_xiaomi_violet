/* Copyright (c) 2020, The Linux Foundation. All rights reserved.
 *
 * This program is free software; you can redistribute it and/or modify
 * it under the terms of the GNU General Public License version 2 and
 * only version 2 as published by the Free Software Foundation.
 *
 * This program is distributed in the hope that it will be useful,
 * but WITHOUT ANY WARRANTY; without even the implied warranty of
 * MERCHANTABILITY or FITNESS FOR A PARTICULAR PURPOSE.  See the
 * GNU General Public License for more details.
 */

&mtp_batterydata {
	#include "qg-batterydata-atl-4000mah.dtsi"
	#include "qg-batterydata-light-4000mah.dtsi"
	#include "qg-batterydata-sun-4000mah.dtsi"
};

&pm6150_qg {
	qcom,cl-disable = <1>;
	qcom,qg-iterm-ma = <300>;
	qcom,vbatt-empty-cold-mv = <3100>;
	qcom,vbatt-empty-mv = <3100>;
	qcom,vbatt-low-cold-mv = <3700>;
	qcom,vbatt-low-mv = <3300>;
};

&pm6150_charger {
	io-channels = <&pm6150_vadc ADC_USB_IN_V_16>,
		      <&pm6150_vadc ADC_USB_IN_I>,
		      <&pm6150_vadc ADC_CHG_TEMP>,
		      <&pm6150_vadc ADC_DIE_TEMP>,
		      <&pm6150_vadc ADC_AMUX_THM4_PU2>,
		      <&pm6150_vadc ADC_SBUx>,
		      <&pm6150_vadc ADC_VPH_PWR>;
	io-channel-names = "usb_in_voltage",
			   "usb_in_current",
			   "chg_temp",
			   "die_temp",
			   "conn_temp",
			   "sbux_res",
			   "vph_voltage";

	google,usb-port-tz-name = "usbc-therm-adc";
	google,wdog_snarl_disable;
	google,sdam_sts_disable;
	qcom,chg-term-src = <1>;
	qcom,chg-term-current-ma = <(-154)>;
	qcom,auto-recharge-soc = <99>;
	qcom,thermal-mitigation = <3000000 2450000 1850000
			925000 500000>;
};
