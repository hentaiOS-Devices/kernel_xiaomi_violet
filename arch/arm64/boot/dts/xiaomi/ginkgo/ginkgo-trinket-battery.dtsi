/* Copyright (c) 2020, The Linux Foundation. All rights reserved.
 *
 * This program is free software; you can redistribute it and/or modify
 * it under the terms of the GNU General Public License version 2 and
 * only version 2 as published by the Free Software Foundation.
 *
 * This program is distributed in the hope that it will be useful,
 * but WITHOUT ANY WARRANTY; without even the implied warranty of
 * MERCHANTABILITY or FITNESS FOR A PARTICULAR PURPOSE.  See the
 * GNU General Public License for more details.
 */

&mtp_batterydata {
	#include "qg-batterydata-atl-4000mah.dtsi"
	#include "qg-batterydata-light-4000mah.dtsi"
	#include "qg-batterydata-unknow-4000mah.dtsi"
};

&pmi632_qg {
	qcom,cl-disable = <1>;
	qcom,qg-iterm-ma = <300>;
	qcom,vbatt-empty-cold-mv = <3100>;
	qcom,vbatt-empty-mv = <3100>;
	qcom,vbatt-low-cold-mv = <3700>;
	qcom,vbatt-low-mv = <3300>;
};

&pmi632_charger {
	qcom,chg-term-current-ma = <(-200)>;
	qcom,sec-charger-config = <0>;
	qcom,auto-recharge-soc = <99>;
	qcom,thermal-mitigation = <3000000 1850000 925000
			500000>;
};
